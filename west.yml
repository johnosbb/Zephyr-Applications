## west.yml
```yaml
# Copyright (c) 2021 Nordic Semiconductor ASA
# SPDX-License-Identifier: Apache-2.0

manifest:
  self:
    west-commands: scripts/west-commands.yml

  remotes:
    - name: zephyrproject-rtos
      url-base: https://github.com/zephyrproject-rtos

  projects:
    # Main Zephyr repository for this workspace
    - name: zephyr
      remote: zephyrproject-rtos
      revision: main
      import:

        name-allowlist:
          - cmsis
          - hal_xtensa
          - hal_espressif
          - hal


    # Edge Impulse Zephyr SDK module
    #
    # This pulls the EI Zephyr module into:
    #   applications/modules/edge-impulse-sdk-zephyr
    #
    # NOTE: SDK_VERSION should match the version specified in the
    # `west.yml` that comes with your exported Zephyr library from
    # Edge Impulse Studio (they use this pattern in their docs).
    #
    # For quick experimentation you can temporarily use `main`
    # as the revision, but for real projects you should use the
    # exact tag 
    - name: edge-impulse-sdk-zephyr
      path: modules/edge-impulse-sdk-zephyr
      revision: ${SDK_VERSION}
      url: https://github.com/edgeimpulse/edge-impulse-sdk-zephyr
```
